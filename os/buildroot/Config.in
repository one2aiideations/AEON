## os/buildroot/Config.in
```kconfig
menu "MOULI"
source "$BR2_EXTERNAL_MOULI_PATH/package/mouli-llama-cpp/Config.in"
endmenu
```

## os/buildroot/package/aeon-llama-cpp/Config.in
```kconfig
config BR2_PACKAGE_AEON_LLAMA_CPP
	bool "aeon-llama-cpp"
	depends on BR2_INSTALL_LIBSTDCPP
	depends on BR2_TOOLCHAIN_HAS_THREADS
	depends on BR2_TOOLCHAIN_GCC_AT_LEAST_9 # C++17
	help
	  llama.cpp inference engine (MIT): llama-server, llama-quantize
	  and the ggml/llama libraries. CPU backend; Vulkan/CUDA come
	  with the GPU work.

	  https://github.com/ggml-org/llama.cpp

comment "aeon-llama-cpp needs a toolchain w/ C++, threads, gcc >= 9"
	depends on !BR2_INSTALL_LIBSTDCPP || !BR2_TOOLCHAIN_HAS_THREADS || \
		!BR2_TOOLCHAIN_GCC_AT_LEAST_9
```

## os/buildroot/package/mouli-llama-cpp/Config.in
```kconfig
config BR2_PACKAGE_MOULI_LLAMA_CPP
	bool "mouli-llama-cpp"
	depends on BR2_INSTALL_LIBSTDCPP
	depends on BR2_TOOLCHAIN_HAS_THREADS
	depends on BR2_TOOLCHAIN_GCC_AT_LEAST_9 # C++17
	help
	  llama.cpp inference engine (MIT): llama-server, llama-quantize
	  and the ggml/llama libraries. CPU backend; Vulkan/CUDA come
	  with the GPU work.

	  https://github.com/ggml-org/llama.cpp

comment "mouli-llama-cpp needs a toolchain w/ C++, threads, gcc >= 9"
	depends on !BR2_INSTALL_LIBSTDCPP || !BR2_TOOLCHAIN_HAS_THREADS || \
		!BR2_TOOLCHAIN_GCC_AT_LEAST_9
```
